## devel/gcc/Config.in
```kconfig
# gcc version configuration
choice
	depends on PACKAGE_gcc
		prompt "GCC package compiler Version" 
		default GCC_8
		config GCC_10
			depends on !arm || GCC_VERSION_10
			bool "gcc version 10.x"
			help
				gcc version 10
		config GCC_9 
			depends on !arm || GCC_VERSION_9 || GCC_VERSION_10
			bool "gcc version 9.x"
			help
				gcc version 9
		config GCC_8 
			bool "gcc version 8.x"
			help
				gcc version 8
		config GCC_7
			bool "gcc version 7.x"
			help
				gcc version 7

endchoice

# gcc library configuration
	config INCLUDE_STATIC_LIBC
	depends on PACKAGE_gcc
		bool "Include static libc on target"
		help
			Copies libc.a to target device
			Increases the size of an already
			very large package
		default n
	config INCLUDE_STATIC_LIBPTHREAD
	depends on PACKAGE_gcc
		bool "Include static libptread on target"
		help
			Copies libpthread.a to target device
			Increases the size of an already
			very large package
		default n
	config INCLUDE_STATIC_LIBSTDC
	depends on PACKAGE_gcc
		bool "Include static libstdc++ on target"
		help
			Copies libstdc++.a to target device
			Increases the size of an already
			very large package
		default n
	config INCLUDE_STATIC_LINK_SPEC
	depends on PACKAGE_gcc
		depends on INCLUDE_STATIC_LIBSTDC
		bool "Generate spec file for easy static c++ linking on target"
		help
			Creates a spec file for gcc to eliminate the need for
			-lstdc++, libgcc_pic and -static-libstdc flags when
			statically linking c++ programs
		default n
```
